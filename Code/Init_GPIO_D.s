GPIO_PORTD_DATA_ALL	EQU 0x400073FC
GPIO_PORTD_DATA_OUT	EQU 0x400073C0
GPIO_PORTD_DIR_R 	EQU 0x40007400
GPIO_PORTD_AFSEL_R 	EQU 0x40007420
GPIO_PORTD_AMSEL_R 	EQU 0x40007528
GPIO_PORTD_DEN_R 	EQU 0x4000751C
GPIO_PORTD_PUR_R 	EQU 0x40007510
GPIO_PORTD_IEV 		EQU 0x4000740C
GPIO_PORTD_IMSK 	EQU 0x40007410
GPIO_PORTD_MIS 		EQU 0x40007418
GPIO_PORTD_ICR 		EQU 0x4000741C
GPIO_PORTD_PCTL		EQU 0x4000752C
GPIO_PORTD_DR8R 	EQU 0x40007508
GPIO_PORTD_SLR	 	EQU 0x40007518
GPIO_PORTD_LOCK 	EQU 0x40007520
GPIO_PORTD_CR 		EQU 0x40007524
SYSCTL_RCGCGPIO		EQU 0x400FE608
SYSCTL_PRGPIO 		EQU 0x400FEA08
GPIO_PORTD_RST		EQU 0x40007100
GPIO_PORTD_DC		EQU 0x40007200 ; (D = 1, C = 0)
	
			AREA INIT_GPIOD_CODE, CODE, READONLY
			THUMB
			EXPORT INIT_GPIOD
				
INIT_GPIOD	PROC
			PUSH 	{R0, R1}
			; Turn On Port D Clock [FEDCBA]
			LDR 	R1, = SYSCTL_RCGCGPIO
			LDR 	R0, [R1]
			ORR 	R0, R0, #0x08
			STR 	R0, [R1]

			; Check Port Ready Status
			LDR 	R1, = SYSCTL_PRGPIO
CHK_PRT		LDR 	R0, [R1]
			ANDS  	R0, #0x08
			BEQ 	CHK_PRT
			
			; Unlock PD7
 			LDR 	R1, =GPIO_PORTD_LOCK
			LDR 	R0, =0x4C4F434B
			STR 	R0, [R1]
			
			LDR 	R1, =GPIO_PORTD_CR
			MOV 	R0, #0xFF
			STRB 	R0, [R1]
			
			; Set Directions
			LDR 	R1, =GPIO_PORTD_DIR_R
			LDR 	R0, [R1]
			BIC 	R0, #0x0F
			ORR 	R0, #0xCB ; [DC, RST, -, -, MOSI, MISO, CS, SCK] (1100.1011)
			STR 	R0, [R1]

			; Enable Digital Port
			LDR 	R1, =GPIO_PORTD_DEN_R
			LDR 	R0, [R1]
			ORR 	R0, #0xCF
			STR 	R0, [R1]
			
			; Enable 8-mA Drive
			LDR 	R1, =GPIO_PORTD_DR8R
			MOV 	R0, #0xFF
			STR 	R0, [R1]
			
			; Enable Slew Rate Control
			LDR 	R1, =GPIO_PORTD_SLR
			MOV 	R0, #0x0F
			STR		R0, [R1]
			
			; Set Pull-Up for RST and CS
			LDR 	R1, =GPIO_PORTD_PUR_R
			LDR 	R0, [R1]
			ORR 	R0, #0x42
			STRB 	R0, [R1]
			
			; Set RST as High
			LDR 	R1, =GPIO_PORTD_RST
			MOV 	R0, #0x40
			STR 	R0, [R1]
			
			; Set as Alternate Function
			LDR 	R1, =GPIO_PORTD_AFSEL_R
			LDR 	R0, [R1]
			ORR 	R0, #0x0F
			STR 	R0, [R1]
			
			; Set as SPI
			LDR 	R1, =GPIO_PORTD_PCTL
			MOV 	R0, #0x1111
			STR		R0, [R1]
			
			POP 	{R0, R1}
			BX 		LR
			ENDP
				
			ALIGN
			END